<footer class="site-footer">
  <div class="footer-inner">
    <div class="footer-main">
      <div class="footer-brand"><a class="brand-link" href="/"><img class="brand-logo" src="/assets/crosspoint-icon.svg" alt="" width="28" height="28" />CrossMux</a><p>Community e-reader firmware for reading and lightweight apps.</p></div>
      <nav class="footer-project"><span class="footer-label">Project</span><a href="https://github.com/0x1abin/crossmux/releases" target="_blank" rel="noopener noreferrer">Releases</a><a href="https://github.com/0x1abin/crossmux" target="_blank" rel="noopener noreferrer">GitHub</a></nav>
    </div>
    <div class="footer-bottom"><span>CrossMux is open-source under the MIT license.</span><span>Built by the community, for the community.</span></div>
  </div>
</footer>
